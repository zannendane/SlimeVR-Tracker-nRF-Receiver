## boards/zannen/zannendongle33_uf2/Kconfig.zannendongle33_uf2
```kconfig
# Copyright (c) 2025 SlimeVR Contributors
# SPDX-License-Identifier: Apache-2.0

config BOARD_ZANNENDONGLE33_UF2
	select SOC_NRF52833_QDAA
```

## boards/zannen/zannendongle33_uf2/board.yml
```yaml
# Copyright (c) 2025 SlimeVR Contributors
# SPDX-License-Identifier: Apache-2.0

board:
  name: zannendongle33_uf2
  vendor: zannen
  socs:
    - name: nrf52833
```

## boards/zannen/zannendongle_uf2/Kconfig.zannendongle_uf2
```kconfig
# Copyright (c) 2025 SlimeVR Contributors
# SPDX-License-Identifier: Apache-2.0

config BOARD_ZANNENDONGLE_UF2
	select SOC_NRF52840_QIAA
```

## boards/zannen/zannendongle_uf2/board.yml
```yaml
# Copyright (c) 2025 SlimeVR Contributors
# SPDX-License-Identifier: Apache-2.0

board:
  name: zannendongle_uf2
  vendor: zannen
  socs:
    - name: nrf52840
```

## sample.yaml
```yaml
tests:
  common:
    platform_allow:
      - nrf21540dk/nrf52840
      - nrf52840dk/nrf52840
      - nrf52840dongle/nrf52840
      - xiao_ble/nrf52840
      - zannendongle_uf2/nrf52840
      - zannendongle33_uf2/nrf52833
    sysbuild: true
```
